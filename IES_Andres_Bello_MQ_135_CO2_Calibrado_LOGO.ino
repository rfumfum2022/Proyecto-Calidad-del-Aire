/*
  MQUnifiedsensor Library - reading an MQ135
  Demonstrates the use a MQ135 sensor. 
  Library originally added 01 may 2019
  by Miguel A Califa, Yersson Carrillo, Ghiordy Contreras, Mario Rodriguez
 
  Added example
  modified 23 May 2019
  by Miguel Califa 
  Updated library usage
  modified 26 March 2020
  by Miguel Califa 

  Code modified by Rosendo Fumero 2022
  
  Wiring:
  https://github.com/miguel5612/MQSensorsLib_Docs/blob/master/static/img/MQ_Arduino.PNG
  Please make sure arduino A0 pin represents the analog input configured on #define pin
 This example code is in the public domain.
 MQ135: https://steemit.com/utopian-io/@cha0s0000/arduino-basics-tutorials-use-mq135-air-quality-detecting-module
 generar bitmap: https://diyusthad.com/image2cpp  https://marlinfw.org/tools/u8glib/converter.html
*/

/* Datos de conexión a ThingSpeak: 
  Channel API Key: SAMJ7XSQ9MWSI5LE
  AULA 1 Channel ID: 1795144 Write API Key: P1L6P3KO906IY5MM Read API Key: ETPVXJBUS5L9MCAU
  AULA 2 Channel ID: 1801920 Write API Key: FYMCEJLACXTS0PLR Read API Key: BKUIR2YA6C7DXYWP
  AULA 3 Channel ID: 1801921 Write API Key: R98BZ53KQ99O8378 Read API Key: CB11V75KNDIOA7BH
  AULA 4 Channel ID: 1801923 Write API Key: FY42LIH306Q85OOL Read API Key: OZWH24YZO14O0UA3

*/

//Include the library
#include <MQUnifiedsensor.h>

#include <ESP8266WiFi.h>
#include <SPI.h>
#include <Wire.h>
#include "MQ135.h"
#include <DHT.h>
#include "ThingSpeak.h" // Include ThingSpeak Library

#include <Adafruit_GFX.h>
#include <Adafruit_SH110X.h>

//Definitions
#define placa "Arduino UNO"
#define Voltage_Resolution 5
#define pin 0 //Analog input 0 of your arduino
#define type "MQ-135" //MQ135
#define ADC_Bit_Resolution 10 // For arduino UNO/MEGA/NANO
#define RatioMQ135CleanAir 8.50//RS / R0 = 3.6 ppm  
//#define calibration_button 13 //Pin to calibrate your sensor

#define i2c_Address 0x3c //initialize with the I2C addr 0x3C Typically eBay OLED's
#define DHTPIN D4 // DHT Digital Input Pin
#define DHTTYPE DHT22 // DHT11 or DHT22, depends on your sensor

 
#define SCREEN_WIDTH 128    // OLED display width, in pixels
#define SCREEN_HEIGHT 64    // OLED display height, in pixels
#define OLED_RESET -1       // Reset pin # (or -1 if sharing Arduino reset pin)
Adafruit_SH1106G display = Adafruit_SH1106G(SCREEN_WIDTH, SCREEN_HEIGHT, &Wire, OLED_RESET);
 

//Declare Sensor
MQUnifiedsensor MQ135(placa, Voltage_Resolution, ADC_Bit_Resolution, pin, type);

String apiKey = "SAMJ7XSQ9MWSI5LE"; // Enter your Write API key from ThingSpeak
const char *ssid = "Medusa_invitado";     // replace with your wifi ssid and wpa2 key
const char *pass = "380061503deb7a";
//const char *ssid = "Tenda_Marcos";     // replace with your wifi ssid and wpa2 key
//const char *pass = "30052005";
const char* server = "api.thingspeak.com";
unsigned long myChannelNumber = 1801921; // Thingspeak número de canal
const char * myWriteAPIKey = "R98BZ53KQ99O8378"; // ThingSpeak write API Key

DHT dht(DHTPIN, DHT22);

WiFiClient client;

#define imageWidth 128
#define imageHeight 64

const unsigned char bitmap_LOGO [] PROGMEM=
{0xff, 0xff, 0xff, 0xff, 0xff, 0xff, 0xff, 0xff, 0xff, 0xff, 0xff, 0xff, 0xff, 0xff, 0xff, 0xff,
0xff, 0xff, 0xff, 0xff, 0xff, 0xff, 0xff, 0xff, 0xff, 0xff, 0xff, 0xff, 0xff, 0xff, 0xff, 0xff,
0xff, 0xff, 0xff, 0xff, 0xff, 0xff, 0xff, 0xff, 0xff, 0xff, 0xff, 0xff, 0xff, 0xff, 0xff, 0xff,
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0xff, 0xff, 0xff, 0xff, 0xff, 0xff, 0xff, 0xff, 0xff, 0xff, 0xff, 0xff, 0xff, 0xff, 0xff, 0xff
};


void setup() {
  //Init the serial port communication - to debug the library
  Serial.begin(9600); //Init serial port

  display.begin(i2c_Address, true); //initialize with the I2C addr 0x3C (128x64)
  display.clearDisplay();
  delay(2000);
  
  // Draw bitmap on the screen
  display.drawBitmap(0, 0, bitmap_LOGO, 128, 64, 1);
  display.display();
  delay(5000);
  
  ThingSpeak.begin(client); // Inicia ThingSpeak

  dht.begin();
  
  Serial.println("Connecting to ");
  Serial.println(ssid);
  
  display.clearDisplay();
  display.setCursor(0,0);  
  display.setTextSize(1);
  display.setTextColor(SH110X_WHITE);
  display.println("Connecting to ");
  display.setTextSize(2);
  display.print(ssid);
  display.display();
  
  WiFi.begin(ssid, pass);
 
  while (WiFi.status() != WL_CONNECTED)
  {
    delay(500);
    Serial.print(".");
  }
    Serial.println("");
    Serial.println("WiFi connected");
    
    display.clearDisplay();
    display.setCursor(0,0);  
    display.setTextSize(1);
    display.setTextColor(SH110X_WHITE);
    display.print("WiFi connected");
    display.display();
  

  //Set math model to calculate the PPM concentration and the value of constants
  MQ135.setRegressionMethod(1); //_PPM =  a*ratio^b
  MQ135.setA(102.2); MQ135.setB(-2.47); // Configure the equation to to calculate NH4 concentration

  /*
    Exponential regression:
  GAS      | a      | b
  CO       | 605.18 | -3.937  
  Alcohol  | 77.255 | -3.18 
  CO2      | 110.47 | -2.862    68.76 |  -2.308
  Toluen  | 44.947 | -3.445
  NH4      | 102.2  | -2.473
  Aceton  | 34.668 | -3.369
  */
  
  /*****************************  MQ Init ********************************************/ 
  //Remarks: Configure the pin of arduino as input.
  /************************************************************************************/ 
  MQ135.init(); 
 
  /* 
    //If the RL value is different from 10K please assign your RL value with the following method:
    MQ135.setRL(10);
  */
  /*****************************  MQ CAlibration ********************************************/ 
  // Explanation: 
   // In this routine the sensor will measure the resistance of the sensor supposedly before being pre-heated
  // and on clean air (Calibration conditions), setting up R0 value.
  // We recomend executing this routine only on setup in laboratory conditions.
  // This routine does not need to be executed on each restart, you can load your R0 value from eeprom.
  // Acknowledgements: https://jayconsystems.com/blog/understanding-a-gas-sensor
  Serial.print("Calibrating please wait.");
  float calcR0 = 0;
  for(int i = 1; i<=1000; i ++)
  {
    MQ135.update(); // Update data, the arduino will read the voltage from the analog pin
    calcR0 += MQ135.calibrate(RatioMQ135CleanAir);
    Serial.print(".");
  }
  MQ135.setR0(calcR0/1000);
  Serial.println("  done!.");
  
  if(isinf(calcR0)) {Serial.println("Warning: Conection issue, R0 is infinite (Open circuit detected) please check your wiring and supply"); while(1);}
  if(calcR0 == 0){Serial.println("Warning: Conection issue found, R0 is zero (Analog pin shorts to ground) please check your wiring and supply"); while(1);}
  /*****************************  MQ CAlibration ********************************************/ 
  MQ135.serialDebug(true);
}

void loop() {
  
  MQ135.update(); // Update data, the arduino will read the voltage from the analog pin
  float ppm = MQ135.readSensor(); // Sensor will read PPM concentration using the model, a and b values set previously or from the setup
  MQ135.serialDebug(); // Will print the table on the serial port
  Serial.println(ppm*1000);

    float air_quality = ppm*1000;
    float h = dht.readHumidity();
    float t = dht.readTemperature();
    
    
    Serial.print("Air Quality: ");  
    Serial.println(" ");
    Serial.print(" | CO2(ppm): "); Serial.print(air_quality);
    Serial.print(" ");
    Serial.print(" | Humedad: ");Serial.print(h);
    Serial.print(" ");
    Serial.print(" | Temperatura: ");Serial.print(t);
 
    display.clearDisplay();
    display.setCursor(0,0);  //oled display
    display.setTextSize(1);
    display.setTextColor(SH110X_WHITE);
    display.println("Air Quality Index");
    display.display();
  
    display.setCursor(0,20);  //oled display
    display.setTextSize(2);
    display.setTextColor(SH110X_WHITE);
    display.print(air_quality);
    display.setTextSize(1);
    display.setTextColor(SH110X_WHITE);
    display.println(" PPM");
    display.println(" "); 
    display.println(" "); 
    
    if (air_quality<=410){
      display.println("aire normal");
      //display.display();
      } else if (air_quality>=410 && air_quality<=1000) {
      display.println("aire con CO2");
      //display.display();  
        } else {
      display.println("¡¡¡DANGER CO2!!!"); 
      //display.display();   
          };
    display.display();
 
 
    if (client.connect(server, 80)) // "184.106.153.149" or api.thingspeak.com
  {
    // Carga los valores a enviar
    ThingSpeak.setField(1, air_quality);
    ThingSpeak.setField(2, t);
    ThingSpeak.setField(3, h);

// Escribe todos los campos a la vez.
    ThingSpeak.writeFields(myChannelNumber, myWriteAPIKey);

    Serial.println("  ¡Datos enviados a ThingSpeak!");
    
  }
    client.stop();
    Serial.println("Waiting...");
   
  
  delay(10000); //Sampling frequency
}
